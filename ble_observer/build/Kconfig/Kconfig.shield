## ble_observer/build/Kconfig/Kconfig.shield
```kconfig
osource "c:/Projects/NordicProjects/beacon/boards/shields/*/Kconfig.shield"
osource "c:/Projects/NordicProjects/ble_scanner/boards/shields/*/Kconfig.shield"
osource "c:/Projects/NordicProjects/ble_observer/boards/shields/*/Kconfig.shield"
osource "C:/ncs/v2.1.2/nrf/boards/shields/*/Kconfig.shield"
```

## ble_observer/build/Kconfig/Kconfig.shield.defconfig
```kconfig
osource "c:/Projects/NordicProjects/beacon/boards/shields/*/Kconfig.defconfig"
osource "c:/Projects/NordicProjects/ble_scanner/boards/shields/*/Kconfig.defconfig"
osource "c:/Projects/NordicProjects/ble_observer/boards/shields/*/Kconfig.defconfig"
osource "C:/ncs/v2.1.2/nrf/boards/shields/*/Kconfig.defconfig"
```

## multiple_adv_sets/build/Kconfig/Kconfig.shield
```kconfig
osource "c:/Projects/NordicProjects/ble_observer/boards/shields/*/Kconfig.shield"
osource "C:/ncs/v2.1.2/nrf/boards/shields/*/Kconfig.shield"
```

## multiple_adv_sets/build/Kconfig/Kconfig.shield.defconfig
```kconfig
osource "c:/Projects/NordicProjects/ble_observer/boards/shields/*/Kconfig.defconfig"
osource "C:/ncs/v2.1.2/nrf/boards/shields/*/Kconfig.defconfig"
```
